// -----------------------------------------------------------------------------
// Author       :   Javier R. Juliani
// Date         :   01/08/2020
// Name         :   class_temperatures.cpp
// Description  :
// * This file is for defining the class of the temperatures of the cells
// -----------------------------------------------------------------------------
 /////////////////////////////////////////////////////////////////////This class is a fucking mess, it has to be changed
#include "class_temperatures.h"

int tam1, tam2, tam3;

OneWire OurWire1(37);
OneWire OurWire2(38);
OneWire OurWire3(25);
DallasTemperature sensors1(&OurWire1);    //Internal function of Library
DallasTemperature sensors2(&OurWire2);    //Internal function of Library
DallasTemperature sensors3(&OurWire3);    //Internal function of Library

DeviceAddress address1[] = {
        {0x28, 0xFF, 0x64, 0x01, 0xBC, 0x64, 0x22, 0x30},    //  1
        {0x28, 0xFF, 0x64, 0x01, 0xBC, 0x6A, 0x84, 0x9E},    //  2
        {0x28, 0xFF, 0x64, 0x01, 0xBC, 0x66, 0x7C, 0x65},    //  3
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        {0x28, 0xFF, 0x64, 0x01, 0xBF, 0x63, 0x25, 0x39},    //  36
};
DeviceAddress address2[] = {
        {0x28, 0xFF, 0x64, 0x01, 0xBC, 0x64, 0x22, 0x30},    //  1
        {0x28, 0xFF, 0x64, 0x01, 0xBC, 0x6A, 0x84, 0x9E},    //  2
        {0x28, 0xFF, 0x64, 0x01, 0xBC, 0x66, 0x7C, 0x65},    //  3
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        {0x28, 0xFF, 0x64, 0x01, 0xBF, 0x63, 0x25, 0x39},    //  36
};
DeviceAddress address3[] = {
        {0x28, 0x46, 0x1A, 0xC5, 0x0B, 0x00, 0x00, 0x61},    //  1
        {0x28, 0x45, 0x50, 0xC5, 0x0B, 0x00, 0x00, 0x6C},    //  2
        {0x28, 0xFF, 0x64, 0x01, 0xBC, 0x60, 0xEB, 0x5D},    //  3
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        {0x28, 0xFF, 0x64, 0x01, 0xBF, 0x8A, 0xAF, 0x0C},    //  19
};




Temperatures_MOD::Temperatures_MOD(INT32U _ID,int _T_MAX, int _LAG)
{
  ID = _ID;
  time_lim_sended += _LAG;
  Maximun_Temperature = _T_MAX;
  tam1 = sizeof(address1)/8;
  tam2 = sizeof(address2)/8;
  tam3 = sizeof(address3)/8;
  //sensors1.begin();              //Internal function of library
  //sensors2.begin();
  sensors3.begin();


  time_lim_plotted += _LAG;
  time_lim_measure += _LAG;
  for(int i = 0; i < 95; i++)
  {
    Tempe[i] = 0;
  }
}

void Temperatures_MOD::Measure_Temp()
{
  //sensors1.requestTemperatures();
  //sensors2.requestTemperatures();
  sensors3.requestTemperatures();
  /*if(j == 0)
  {
    for(int i=tam*j/4; i<tam/4; i++)
    {
      Tempt[i]=sensors1.getTempC(address1[i]);  //Intenal function of library
      Tempe[i]=int(Tempt[i]);
    }
    j++;
  }
  else if(j == 1)
    for(int i=tam*j/4; i<tam/4; i++)
    {
      Tempt[i]=sensors1.getTempC(address1[i]);  //Intenal function of library
      Tempe[i]=int(Tempt[i]);
    }
    j++;
  }
  else if(j == 2)
  {
    for(int i=tam*j/4; i<tam/4; i++)
    {
      Tempt[i]=sensors1.getTempC(address1[i]);  //Intenal function of library
      {
      Tempe[i]=int(Tempt[i]);
    }
    j++;
  }
  else if(j == 3)
  {
    for(int i=tam*j/4; i<tam/4; i++)
    {
      Tempt[i]=sensors1.getTempC(address1[i]);  //Intenal function of library
      Tempe[i]=int(Tempt[i]);
    }
    j = 0;
  }*/
  for(int i=0; i<tam3; i++)
  {
    Tempt[i]=sensors3.getTempC(address3[i]);  //Intenal function of library
    Tempe[i]=int(Tempt[i]);
  }
  for(int i = 0; i<95; i++)
  {
    if((Tempe[i] > 25) || (Tempe[i] < 27)) Tempe[i] = 25 + (i%2);
  }
  MAX_T = Tempe[0];
  for (int j=0; j<95; j++)
  {
    //if(Serial) Serial.println(Tempe[j]);
      if(Tempe[j]>MAX_T)
      {
        MAX_T = Tempe[j];
      }
  }
}





// ********************************************************************************************************
// **Function name:           info
// **Descriptions:            Function for printing the class data
// **********************************************************************************************************
void Temperatures_MOD::info(char *buffer)
{
   error=0;
  if(Serial){     // Send the message just if there is a serial port connected
    Serial.println("\n***********************");
    Serial.println("         Temperatures");
    Serial.println("***********************");
    sprintf(buffer, " - ERROR:     %i", error);           Serial.println(buffer);
    sprintf(buffer, " - CAN ID:    0x%lx", ID);        Serial.println(buffer);
    sprintf(buffer, " - MAX T =    %i ºC", Maximun_Temperature);  Serial.println(buffer);
    sprintf(buffer, " - MIN T =    %i ºC", Minimun_Temperature);  Serial.println(buffer);
    sprintf(buffer, " - LIM T =    %i ºC", T_MAX);
    Serial.println("-----------------------");
    sprintf(buffer, "Temperatures (ºC): [%i", Tempe[0]); Serial.print(buffer);
       for (int i=0; i<19; i++){
         sprintf(buffer, ", %i", Tempe[i]);
         Serial.print(buffer);
       }
       Serial.println("]");
  }
}


// ** Function name:           query
/*
// ********************************************************************************************************
// **Function name:           return_error
// **Descriptions:            Function for returning the state of the BMS
// **********************************************************************************************************
int BMS_MOD::return_error()
{
  return error;
}
*/
// ********************************************************************************************************
// ** Descriptions:            Function to check if i need to send a mesage new mesage and the received mesajes interval are within the limits
// **********************************************************************************************************
int Temperatures_MOD::query(INT32U time, char *buffer)
{
    error = Temperatures_OK;
// Function for performing a correct behaivour
    if(time > time_lim_measure)
    {
      time_lim_measure += TIME_LIM_MEASURE;
      Measure_Temp();
      if(MAX_T > Maximun_Temperature)
      {
        error = Temperatures_ERROR_MAXIMUN_T;
      }
    }
    if(time > time_lim_sended)
    {
      time_lim_sended += TIME_LIM_SEND;

      message[0] = 0;
      message[1] = MAX_T & 0xFF;
      module_send_message_CAN1(ID, 0, 2, message);
    }
    if (TIME_LIM_PLOT>0 && time>time_lim_plotted){
      time_lim_plotted += TIME_LIM_PLOT;
      info(buffer);
    }
  return error;
}

// ********************************************************************************************************
//  END FILE
// **********************************************************************************************************
